// Brushless motor library
// copyright Alexandre Iooss, 2017-2018
// Please see README.txt for license information

#include "SinArray.h"
#include "Arduino.h"

#ifdef SIN_GENERATOR

unsigned int sin_array[N_VALUES];

#else

const int PROGMEM sin_array[N_VALUES] = {
0x0000, 0x0192, 0x0324, 0x04B6, 0x0647, 0x07D9, 0x096A, 0x0AFB, 0x0C8B, 0x0E1B, 0x0FAB, 0x1139, 0x12C7, 0x1455, 0x15E1, 0x176D, 
0x18F8, 0x1A82, 0x1C0B, 0x1D93, 0x1F19, 0x209F, 0x2223, 0x23A6, 0x2527, 0x26A7, 0x2826, 0x29A3, 0x2B1E, 0x2C98, 0x2E10, 0x2F86, 
0x30FB, 0x326D, 0x33DE, 0x354D, 0x36B9, 0x3824, 0x398C, 0x3AF2, 0x3C56, 0x3DB7, 0x3F16, 0x4073, 0x41CD, 0x4325, 0x447A, 0x45CC, 
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0xE708, 0xE893, 0xEA1F, 0xEBAB, 0xED39, 0xEEC7, 0xF055, 0xF1E5, 0xF375, 0xF505, 0xF696, 0xF827, 0xF9B9, 0xFB4A, 0xFCDC, 0xFE6E };

#endif

void SinArray::generate()
{
#ifdef SIN_GENERATOR
  // Generate sin array
  Serial.println();
  Serial.println("const int PROGMEM sin_array[N_VALUES] = {");
  for (int i = 0; i < N_VALUES; i++)
  {
    if((i % 16) == 0) Serial.println();
    sin_array[i] = sin(2. * M_PI * i / (double)N_VALUES) * STORE_TYPE_RANGE;
    Serial.print("0x");
    if(sin_array[i] <= 0x0FFF) Serial.print("0");
    if(sin_array[i] <= 0x00FF) Serial.print("0");
    if(sin_array[i] <= 0x000F) Serial.print("0");
    Serial.print(sin_array[i], HEX);
    if(i==N_VALUES-1) Serial.print(" };");
    else Serial.print(", ");
  }
#endif
}

double SinArray::getSinByOffset(int offset)
{
  // Offset must be positive and between  and N_VALUES-1
  offset = offset % N_VALUES;
  if (offset < 0) offset = N_VALUES + offset;
  return sin_array[offset] / (double)STORE_TYPE_RANGE;
}

double SinArray::getSinDegree(double a)
{
  int offset = (a * N_VALUES) / 360;
  return getSinByOffset(offset);
}

double SinArray::getSin(double r)
{
  int offset = (r * N_VALUES) / (2. * M_PI);
  return getSinByOffset(offset);
}
